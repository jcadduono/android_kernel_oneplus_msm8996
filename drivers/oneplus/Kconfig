## drivers/oneplus/Kconfig
```kconfig
config OEM_DEBUG_SUPORT
	bool "OnePlus OEM debugging support"

config OEM_TRACE_SUPORT
	depends on OEM_DEBUG_SUPORT
	bool "OnePlus OEM trace function"
	help
	  Enabling this will register the device under /dev/otracer.

config OEM_FORCE_DUMP
	bool "OnePlus OEM force dump function"

config OEM_PROJECT_INFO
	bool "OnePlus OEM project info for OnePlus 3"

config RF_CABLE_DETECT
	bool "OnePlus detect RF cable connection"
	help
	  detect RF cable connection for different RF configuration

config OP_GPL_HELPER
	bool "Oneplus CoreTech helper, wrapper for exporting GPL SYMBOL"

config OP_STRUCT_OFFSET_HELPER
	bool "Oneplus CoreTech helper, used for struct member dereference"

source "drivers/oneplus/coretech/Kconfig"

source "drivers/oneplus/param_read_write/Kconfig"
```

## drivers/oneplus/param_read_write/Kconfig
```kconfig
config PARAM_READ_WRITE
	bool "Param partition read/write support"
	help
	  If you want to read/write the param partition in kernel,
	  then you must say Y here.
```
